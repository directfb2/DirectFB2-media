## Kconfig
```kconfig
#  This file is part of DirectFB.
#
#  This library is free software; you can redistribute it and/or
#  modify it under the terms of the GNU Lesser General Public
#  License as published by the Free Software Foundation; either
#  version 2.1 of the License, or (at your option) any later version.
#
#  This library is distributed in the hope that it will be useful,
#  but WITHOUT ANY WARRANTY; without even the implied warranty of
#  MERCHANTABILITY or FITNESS FOR A PARTICULAR PURPOSE.  See the GNU
#  Lesser General Public License for more details.
#
#  You should have received a copy of the GNU Lesser General Public
#  License along with this library; if not, write to the Free Software
#  Foundation, Inc., 51 Franklin Street, Fifth Floor, Boston, MA 02110-1301, USA

menu "DirectFB2-media"

config GRAPHICS_DIRECTFB2_MEDIA_BMP
	bool "BMP image provider"
	depends on GRAPHICS_DIRECTFB2
	default n

config GRAPHICS_DIRECTFB2_MEDIA_GIF
	bool "GIF image provider"
	depends on GRAPHICS_DIRECTFB2
	default n

config GRAPHICS_DIRECTFB2_MEDIA_LODEPNG
	bool "LodePNG image provider"
	depends on GRAPHICS_DIRECTFB2
	default n

if GRAPHICS_DIRECTFB2_MEDIA_LODEPNG

config GRAPHICS_DIRECTFB2_MEDIA_LODEPNG_DIR
	string "LodePNG source directory"
	default "lodepng"

endif # GRAPHICS_DIRECTFB2_MEDIA_LODEPNG

config GRAPHICS_DIRECTFB2_MEDIA_NANOSVG
	bool "NanoSVG image provider"
	depends on GRAPHICS_DIRECTFB2
	default n

if GRAPHICS_DIRECTFB2_MEDIA_NANOSVG

config GRAPHICS_DIRECTFB2_MEDIA_NANOSVG_DIR
	string "NanoSVG source directory"
	default "nanosvg/src"

endif # GRAPHICS_DIRECTFB2_MEDIA_NANOSVG

config GRAPHICS_DIRECTFB2_MEDIA_PL_MPEG
	bool "PL_MPEG video provider"
	depends on GRAPHICS_DIRECTFB2
	default n

if GRAPHICS_DIRECTFB2_MEDIA_PL_MPEG

config GRAPHICS_DIRECTFB2_MEDIA_PL_MPEG_DIR
	string "PL_MPEG source directory"
	default "pl_mpeg"

endif # GRAPHICS_DIRECTFB2_MEDIA_PL_MPEG

config GRAPHICS_DIRECTFB2_MEDIA_SCHRIFT
	bool "Schrift font provider"
	depends on GRAPHICS_DIRECTFB2
	default n

if GRAPHICS_DIRECTFB2_MEDIA_SCHRIFT

config GRAPHICS_DIRECTFB2_MEDIA_SCHRIFT_DIR
	string "Schrift source directory"
	default "libschrift"

endif # GRAPHICS_DIRECTFB2_MEDIA_SCHRIFT

config GRAPHICS_DIRECTFB2_MEDIA_SPNG
	bool "Simple PNG image provider"
	depends on GRAPHICS_DIRECTFB2
	default n

if GRAPHICS_DIRECTFB2_MEDIA_SPNG

config GRAPHICS_DIRECTFB2_MEDIA_SPNG_DIR
	string "Simple PNG source directory"
	default "libspng"

config GRAPHICS_DIRECTFB2_MEDIA_MINIZ_DIR
	string "Miniz source directory"
	default "miniz"

endif # GRAPHICS_DIRECTFB2_MEDIA_SPNG

config GRAPHICS_DIRECTFB2_MEDIA_STB
	bool "STB font provider and image provider"
	depends on GRAPHICS_DIRECTFB2
	default n

if GRAPHICS_DIRECTFB2_MEDIA_STB

config GRAPHICS_DIRECTFB2_MEDIA_STB_DIR
	string "STB source directory"
	default "stb"

endif # GRAPHICS_DIRECTFB2_MEDIA_STB

endmenu
```
